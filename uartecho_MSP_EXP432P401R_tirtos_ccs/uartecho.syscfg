// These arguments were used when this file was generated. They will be automatically applied on subsequent loads 
// via the GUI or CLI invocations. Run CLI with '--help' for additional information on how to override these arguments.
// @cliArgs --board "/ti/boards/MSP_EXP432P401R" --product "simplelink_msp432p4_sdk@3.30.00.13"
// @versions {"data":"2019051709","timestamp":"2019051709","tool":"1.1.792","templates":"2019051709"}

var RTOS = scripting.addModule("/ti/drivers/RTOS");
var GPIO = scripting.addModule("/ti/drivers/GPIO");
var GPIO1 = GPIO.addInstance();
var UART = scripting.addModule("/ti/drivers/UART");
var UART1 = UART.addInstance();
var UART2 = UART.addInstance();
var GPIO2 = GPIO.addInstance();
var GPIO3 = GPIO.addInstance();
var Timer = scripting.addModule("/ti/drivers/Timer");
var Timer1 = Timer.addInstance();
var GPIO4 = GPIO.addInstance();
var Timer2 = Timer.addInstance();
var GPIO5 = GPIO.addInstance();
var GPIO6 = GPIO.addInstance();
var GPIO7 = GPIO.addInstance();
// Name
RTOS.timer0.resource.$name = "MyTIMER_A1";
var Power = scripting.addModule("/ti/drivers/Power");
// Initial Performance Level - The performance level at system start up.
Power.initialPerformanceLevel = 3;
// Name
Power.performanceLevel3.$name = "ti_drivers_power_PowerMSP432PerfLevels0";
// Name
Power.performanceLevel2.$name = "ti_drivers_power_PowerMSP432PerfLevels1";
// Name
Power.performanceLevel1.$name = "ti_drivers_power_PowerMSP432PerfLevels2";
// Name
Power.performanceLevel0.$name = "ti_drivers_power_PowerMSP432PerfLevels3";
var Board = scripting.addModule("/ti/drivers/Board");
var DriverLib = scripting.addModule("/ti/devices/DriverLib");
// Name - The C/C++ identifier used in applications as the index parameter passed to GPIO runtime APIs
GPIO1.$name = "CONFIG_TRIGGER_PIN";
// Mode - Select the GPIO mode
GPIO1.mode = "Output";
// Assign pin
GPIO1.gpioPin.$assign = "boosterpack.40"; // P2.7
// Name - The C/C++ identifier used in applications as the index parameter passed to UART runtime APIs
UART1.$name = "CONFIG_UART_0";
// Use Hardware - Select the hardware to use, or 'none' to use available header pins
UART1.$hardware = system.deviceData.board.components.XDS110UART;
// Name
UART1.uart.$name = "MyUART1";
// Name - The C/C++ identifier used in applications as the index parameter passed to UART runtime APIs
UART2.$name = "CONFIG_UART_1";
// Name
UART2.uart.$name = "MyUART1";
// Use Peripheral
UART2.uart.$assign = "EUSCI_A2";
// Assign pin
UART2.uart.txPin.$assign = "boosterpack.4"; // P3.3
// Assign pin
UART2.uart.rxPin.$assign = "boosterpack.3"; // P3.2
// Name - The C/C++ identifier used in applications as the index parameter passed to GPIO runtime APIs
GPIO2.$name = "CONFIG_GPIO_0";
// Interrupt Trigger - Specifies when or if interrupts are triggered
GPIO3.interruptTrigger = "Both Edges";
// Name - The C/C++ identifier used in applications as the index parameter passed to GPIO runtime APIs
GPIO3.$name = "CONFIG_ECHO_PIN";
// Assign pin
GPIO3.gpioPin.$assign = "boosterpack.39"; // P2.6
// Name - The C/C++ identifier used in applications as the index parameter passed to Timer runtime APIs
Timer1.$name = "CONFIG_TIMER_0";
// Clock Source - Specifies the clock source of the timer peripheral
Timer1.clockSource = "SMCLK";
// Timer Type
Timer1.timerType = "32 Bits";
// Name
Timer1.timer.$name = "MyTIMER321";
// Name - The C/C++ identifier used in applications as the index parameter passed to GPIO runtime APIs
GPIO4.$name = "CONFIG_GPIO_LED_0";
// Use Hardware - Select the hardware to use, or 'none' to use available header pins
GPIO4.$hardware = system.deviceData.board.components.LED1_RED;
// Output Strength - Specifies the output strength
GPIO4.outputStrength = "High";
// Name - The C/C++ identifier used in applications as the index parameter passed to Timer runtime APIs
Timer2.$name = "CONFIG_TIMER_1";
// Interrupt Priority - Timer Interrupt Priority
Timer2.interruptPriority = "6";
// Name
Timer2.timer.$name = "MyTIMER_A1";
// Use Peripheral
Timer2.timer.$assign = "Timer_A1";
// Name - The C/C++ identifier used in applications as the index parameter passed to GPIO runtime APIs
GPIO5.$name = "CONFIG_PIR_ECHO_PIN";
// Callback Function - The name of the callback function called when this GPIO pin triggers an interrupt, or 'NULL' if it's specified at runtime
GPIO5.callbackFunction = "";
// Assign pin
GPIO5.gpioPin.$assign = "boosterpack.7"; // P1.5
// Name - The C/C++ identifier used in applications as the index parameter passed to GPIO runtime APIs
GPIO6.$name = "CONFIG_BUZZER_OUT_PIN";
// Mode - Select the GPIO mode
GPIO6.mode = "Output";
// Output Strength - Specifies the output strength
GPIO6.outputStrength = "High";
// Assign pin
GPIO6.gpioPin.$assign = "boosterpack.10"; // P6.4
// Mode - Select the GPIO mode
GPIO7.mode = "Output";
// Use Hardware - Select the hardware to use, or 'none' to use available header pins
GPIO7.$hardware = system.deviceData.board.components.LED2_GREEN;
// Name - The C/C++ identifier used in applications as the index parameter passed to GPIO runtime APIs
GPIO7.$name = "CONFIG_LED_PIN_GREEN";
// Suggest solution
RTOS.timer0.resource.$suggestSolution = "Timer_A0";
// Suggest solution
UART1.uart.$suggestSolution = "EUSCI_A0";
// Suggest solution
UART1.uart.txPin.$suggestSolution = "7";
// Suggest solution
UART1.uart.rxPin.$suggestSolution = "6";
// Suggest solution
GPIO2.gpioPin.$suggestSolution = "1";
// Suggest solution
Timer1.timer.$suggestSolution = "TIMER32_0";
// Suggest solution
GPIO4.gpioPin.$suggestSolution = "4";
// Suggest solution
GPIO7.gpioPin.$suggestSolution = "17";
